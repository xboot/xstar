## Kconfig
```kconfig
mainmenu "Xstar Configuration"

menu "Compile Options"

config CROSS_COMPILE
	string "Cross-compiler toolchain prefix"
	default ""
	help
		Specify the prefix for the cross-compiler toolchain. This is the string
		that is prepended to compiler tool names (gcc, ld, etc.) when building
		for a different architecture.

config ARCH
	string
	default "arm32" if ARCH_ARM32
	default "arm64" if ARCH_ARM64
	default "riscv32" if ARCH_RISCV32
	default "riscv64" if ARCH_RISCV64
	default "x32" if ARCH_X32
	default "x64" if ARCH_X64

choice
	prompt "Architecture type"
	default ARCH_X64
	help
		Select the target CPU architecture. This determines the
		cross-compiler toolchain, platform-specific source files and
		linker settings used for the build. The selected value is
		exposed as CONFIG_ARCH (e.g. "arm32", "x64") for use by the
		build system.

	config ARCH_ARM32
		bool "ARM 32-bits"
	config ARCH_ARM64
		bool "ARM 64-bits"
	config ARCH_RISCV32
		bool "RISC-V 32-bits"
	config ARCH_RISCV64
		bool "RISC-V 64-bits"
	config ARCH_X32
		bool "X86 32-bits"
	config ARCH_X64
		bool "X86 64-bits"
endchoice

config OPTIMIZE_LEVEL
	string
	default "-O0" if OPTIMIZE_LEVEL_O0
	default "-O1" if OPTIMIZE_LEVEL_O1
	default "-O2" if OPTIMIZE_LEVEL_O2
	default "-O3" if OPTIMIZE_LEVEL_O3
	default "-Os" if OPTIMIZE_LEVEL_OS

choice
	prompt "Optimization level"
	default OPTIMIZE_LEVEL_O3
	help
		Compiler optimization level. Common values:
		-O0: No optimization
		-O1: Basic optimization
		-O2: Moderate optimization
		-O3: Aggressive optimization
		-Os: Optimize for size

config OPTIMIZE_LEVEL_O0
	bool "-O0"
config OPTIMIZE_LEVEL_O1
	bool "-O1"
config OPTIMIZE_LEVEL_O2
	bool "-O2"
config OPTIMIZE_LEVEL_O3
	bool "-O3"
config OPTIMIZE_LEVEL_OS
	bool "-Os"
endchoice

config DEBUG_SYMBOL
	bool "Generate debug symbols (-g -ggdb)"
	default y
	help
		Enable generation of debug information (-g -ggdb) for use with
		gdb. Disable for release builds to reduce object file size.

endmenu

source "projects/Kconfig"
source "packages/Kconfig"
source "xstar/Kconfig"
```

## packages/lvgl-9.6.0/Kconfig
```kconfig
menuconfig PKG_LVGL
	bool "Enable lvgl package"
	default n
	help
		Enable the lvgl package.

config CMD_TINYUI
	bool "Enable lvgl tinyui command"
	depends on PKG_LVGL
	default y
	help
		Enable the lvgl tinyui command for demo.
```

## xstar/driver/ledstrip/Kconfig
```kconfig
menu "LED Strip Support"

config DRV_LEDSTRIP_SK9822
	prompt "Enable SK9822 LED strip driver"
	bool
	default n

config DRV_LEDSTRIP_WS2812B
	prompt "Enable WS2812B LED strip driver"
	bool
	default n

endmenu
```
