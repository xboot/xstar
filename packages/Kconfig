## packages/Kconfig
```kconfig
menu "Package Libraries"

source "packages/libc-0.0.0/Kconfig"
source "packages/libm-0.0.0/Kconfig"

source "packages/libcjson-0.0.0/Kconfig"
source "packages/libxnes-1.0.0/Kconfig"
source "packages/lvgl-9.4.0/Kconfig"
source "packages/plmpeg-0.0.0/Kconfig"
source "packages/vww-0.0.0/Kconfig"
source "packages/wboxtest-0.0.0/Kconfig"
source "packages/xaf-0.0.0/Kconfig"
source "packages/xui-0.0.0/Kconfig"

endmenu
```

## packages/libc-0.0.0/Kconfig
```kconfig
config PKG_LIBC
	bool "Enable libc (baremetal) package"
	default n
	help
		Enable the libc package for C standard library.
```

## packages/libcjson-0.0.0/Kconfig
```kconfig
config PKG_LIBCJSON
	bool "Enable libcjson package"
	default n
	help
		Enable the libcjson package for json parser.
```

## packages/libm-0.0.0/Kconfig
```kconfig
config PKG_LIBM
	bool "Enable libm (baremetal) package"
	default n
	help
		Enable the libm package for C math library.
```

## packages/libxnes-1.0.0/Kconfig
```kconfig
menuconfig PKG_LIBXNES
	bool "Enable libxnes package"
	default n
	help
		Enable the libxnes package for NES emulation.

config CMD_XNES
	bool "Enable xnes command"
	depends on PKG_LIBXNES
	default y
	help
		Enable the command line tool for xnes.
```

## packages/lvgl-9.4.0/Kconfig
```kconfig
menuconfig PKG_LVGL
	bool "Enable lvgl package"
	default n
	help
		Enable the lvgl package.

config CMD_LVGL
	bool "Enable lvgl command"
	depends on PKG_LVGL
	default y
	help
		Enable the lvgl command for demo.
```

## packages/plmpeg-0.0.0/Kconfig
```kconfig
menuconfig PKG_PLMPEG
	bool "plmpeg video player"
	default n
	help
		plmpeg is a video player for MPEG1 (VCD) files.

config CMD_PLMPEG
	bool "Enable plmpeg command"
	depends on PKG_PLMPEG
	default y
	help
		Enable the plmpeg command to play MPEG1 videos.
```

## packages/vww-0.0.0/Kconfig
```kconfig
menuconfig PKG_VWW
	bool "VWW visual wake words neural network library"
	default n
	help
		Enable support for the VWW visual wake words library.
		This provides a quantized CNN model for person detection.

config CMD_VWW
	bool "Enable vww command"
	depends on PKG_VWW
	default y
	help
		Enable the vww command to run person detection on an image.
```

## packages/wboxtest-0.0.0/Kconfig
```kconfig
menuconfig PKG_WBOXTEST
	bool "Enable wboxtest package"
	default n
	help
		Enable the wboxtest package for whitebox testing of various modules.

source "packages/wboxtest-0.0.0/benchmark-graphic/Kconfig"
source "packages/wboxtest-0.0.0/benchmark-memory/Kconfig"
source "packages/wboxtest-0.0.0/block/Kconfig"
source "packages/wboxtest-0.0.0/camera/Kconfig"
source "packages/wboxtest-0.0.0/coroutine/Kconfig"
source "packages/wboxtest-0.0.0/crypto/Kconfig"
source "packages/wboxtest-0.0.0/dma/Kconfig"
source "packages/wboxtest-0.0.0/other/Kconfig"
source "packages/wboxtest-0.0.0/path/Kconfig"
source "packages/wboxtest-0.0.0/stdio/Kconfig"
source "packages/wboxtest-0.0.0/thread/Kconfig"
```

## packages/wboxtest-0.0.0/benchmark-graphic/Kconfig
```kconfig
config WBOXTEST_BENCHMARK_GRAPHIC
	bool "Enable graphic benchmark tests"
	depends on PKG_WBOXTEST
	default y
	help
		Enable benchmark tests for graphic operations like arc, circle, etc.
```

## packages/wboxtest-0.0.0/benchmark-memory/Kconfig
```kconfig
config WBOXTEST_BENCHMARK_MEMORY
	bool "Enable memory benchmark tests"
	depends on PKG_WBOXTEST
	default y
	help
		Enable benchmark tests for memory functions like memcpy, memset, etc.
```

## packages/wboxtest-0.0.0/block/Kconfig
```kconfig
config WBOXTEST_BLOCK
	bool "Enable block tests"
	depends on PKG_WBOXTEST
	default y
	help
		Enable tests for block operations.
```

## packages/wboxtest-0.0.0/camera/Kconfig
```kconfig
config WBOXTEST_CAMERA
	bool "Enable camera tests"
	depends on PKG_WBOXTEST
	default y
	help
		Enable tests for camera operations.
```

## packages/wboxtest-0.0.0/coroutine/Kconfig
```kconfig
config WBOXTEST_COROUTINE
	bool "Enable coroutine tests"
	depends on PKG_WBOXTEST
	default y
	help
		Enable tests for coroutine operations.
```

## packages/wboxtest-0.0.0/crypto/Kconfig
```kconfig
config WBOXTEST_CRYPTO
	bool "Enable crypto tests"
	depends on PKG_WBOXTEST
	default y
	help
		Enable tests for crypto operations.
```

## packages/wboxtest-0.0.0/dma/Kconfig
```kconfig
config WBOXTEST_DMA
	bool "Enable dma tests"
	depends on PKG_WBOXTEST
	default y
	help
		Enable tests for dma operations.
```

## packages/wboxtest-0.0.0/other/Kconfig
```kconfig
config WBOXTEST_OTHER
	bool "Enable other tests"
	depends on PKG_WBOXTEST
	default y
	help
		Enable tests for other operations.
```

## packages/wboxtest-0.0.0/path/Kconfig
```kconfig
config WBOXTEST_PATH
	bool "Enable path tests"
	depends on PKG_WBOXTEST
	default y
	help
		Enable tests for path operations.
```

## packages/wboxtest-0.0.0/stdio/Kconfig
```kconfig
config WBOXTEST_STDIO
	bool "Enable stdio tests"
	depends on PKG_WBOXTEST
	default y
	help
		Enable tests for stdio operations.
```

## packages/wboxtest-0.0.0/thread/Kconfig
```kconfig
config WBOXTEST_THREAD
	bool "Enable thread tests"
	depends on PKG_WBOXTEST
	default y
	help
		Enable tests for thread operations.
```

## packages/xaf-0.0.0/Kconfig
```kconfig
menuconfig PKG_XAF
	bool "xaf video player"
	default n
	help
		Enable support for the XAF (X Animation Format) video player.
		A lightweight Cinepak-based video container decoder, pure C99
		with zero external dependencies.

config CMD_XAF
	bool "Enable xaf command"
	depends on PKG_XAF
	default y
	help
		Enable the xaf command to play XAF (X Animation Format) video files.
```

## packages/xui-0.0.0/Kconfig
```kconfig
menuconfig PKG_XUI
	bool "XUI immediate mode gui library"
	default n
	help
		Enable support for the XUI user interface library.
		This provides various UI components like buttons, panels, etc.

config CMD_OVERVIEW
	bool "Enable overview command"
	depends on PKG_XUI
	default y
	help
		Enable the overview command to demonstrate XUI components.
```

## projects/Kconfig
```kconfig
menu "Project Selection"

config PROJECT_NAME
	prompt "Project Name"
	string
	default "x64-linux-sdl-helloworld"
	help
		This is the project directory name to be selected. Please ensure
		the project directory exists.
endmenu

source "projects/.kconfig.projects"
```

## xstar/Kconfig
```kconfig
menu "Xstar Options"

config XSTAR
	bool
	default y
	select DRV_BLOCK_ROMDISK
	select DRV_CONSOLE_UART
	select CMD_HELP

config XSTAR_LOG
	bool "Enable LOG macro output"
	default y
	help
		If disabled, all LOG() macros are compiled as no-ops. This completely
		removes logging code from the binary, improving performance and reducing
		binary size at the cost of losing all debug output.

config XSTAR_LOGGER_SIZE
	int "Logger circular buffer size"
	default 8192
	help
		Size of the circular buffer used by the logger. Larger values allow more
		logs to be buffered but consume more memory.

config XSTAR_MAX_PATH
	int "Maximum path length"
	default 1024
	help
		Maximum path length for shell commands.

choice
	prompt "Window default orientation"
	default XSTAR_WINDOW_ORIENTATION_ROTATE_0
	help
		Default orientation of the window display.

config XSTAR_WINDOW_ORIENTATION_ROTATE_0
	bool "Rotate 0"
	help
		No rotation (identity), display content as-is.

config XSTAR_WINDOW_ORIENTATION_ROTATE_90
	bool "Rotate 90"
	help
		Rotate display content 90 degrees counter-clockwise.

config XSTAR_WINDOW_ORIENTATION_ROTATE_180
	bool "Rotate 180"
	help
		Rotate display content 180 degrees counter-clockwise (upside down).

config XSTAR_WINDOW_ORIENTATION_ROTATE_270
	bool "Rotate 270"
	help
		Rotate display content 270 degrees counter-clockwise.

config XSTAR_WINDOW_ORIENTATION_FLIP_HORIZONTAL
	bool "Flip horizontal"
	help
		Flip display content horizontally, reflect across y-axis (mirror left-right).

config XSTAR_WINDOW_ORIENTATION_FLIP_DIAGONAL
	bool "Flip main diagonal"
	help
		Flip display content across the main diagonal, reflect across y = x.

config XSTAR_WINDOW_ORIENTATION_FLIP_VERTICAL
	bool "Flip vertical"
	help
		Flip display content vertically, reflect across x-axis (mirror top-bottom).

config XSTAR_WINDOW_ORIENTATION_FLIP_ANTI_DIAGONAL
	bool "Flip anti-diagonal"
	help
		Flip display content across the anti-diagonal, reflect across y = -x.
endchoice

config XSTAR_WINDOW_ORIENTATION
	int
	default 0 if XSTAR_WINDOW_ORIENTATION_ROTATE_0
	default 1 if XSTAR_WINDOW_ORIENTATION_ROTATE_90
	default 2 if XSTAR_WINDOW_ORIENTATION_ROTATE_180
	default 3 if XSTAR_WINDOW_ORIENTATION_ROTATE_270
	default 4 if XSTAR_WINDOW_ORIENTATION_FLIP_HORIZONTAL
	default 5 if XSTAR_WINDOW_ORIENTATION_FLIP_DIAGONAL
	default 6 if XSTAR_WINDOW_ORIENTATION_FLIP_VERTICAL
	default 7 if XSTAR_WINDOW_ORIENTATION_FLIP_ANTI_DIAGONAL

config XSTAR_SHELL_PASSWORD
	string "SHA256 hash for shell password"
	default ""
	help
		SHA256 hash (not raw password) for shell authentication. Leave empty to disable.
		Generate using: echo -n password | sha256sum
endmenu

source "xstar/driver/Kconfig"
source "xstar/external/Kconfig"
source "xstar/kernel/Kconfig"
source "xstar/libx/Kconfig"
source "xstar/xos/Kconfig"
```
