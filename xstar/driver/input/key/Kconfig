## xstar/driver/input/key/Kconfig
```kconfig
menu "Key Support"

config DRV_INPUT_KEY_ADC
	prompt "Enable ADC key driver"
	bool
	default n

config DRV_INPUT_KEY_GPIO
	prompt "Enable GPIO key driver"
	bool
	default n

config DRV_INPUT_KEY_GPIO_MATRIX
	prompt "Enable GPIO matrix key driver"
	bool
	default n

config DRV_INPUT_KEY_GPIO_POLLED
	prompt "Enable GPIO polled key driver"
	bool
	default n

endmenu
```

## xstar/driver/input/rc/Kconfig
```kconfig
menu "Remote Control Support"

config DRV_INPUT_RC_GPIO
	prompt "Enable GPIO RC driver"
	bool
	default n

endmenu
```

## xstar/driver/input/rotary/Kconfig
```kconfig
menu "Rotary Encoder Support"

config DRV_INPUT_ROTARY_GPIO
	prompt "Enable GPIO rotary encoder driver"
	bool
	default n

endmenu
```

## xstar/driver/input/touchscreen/Kconfig
```kconfig
menu "Touchscreen Support"

config DRV_INPUT_TOUCHSCREEN_CST816D
	prompt "Enable CST816D touchscreen driver"
	bool
	default n

config DRV_INPUT_TOUCHSCREEN_GT911
	prompt "Enable GT911 touchscreen driver"
	bool
	default n

endmenu
```

## xstar/driver/led/Kconfig
```kconfig
menu "LED Support"

config DRV_LED_GPIO
	prompt "Enable gpio led driver"
	bool
	default n
	help
		This option enables support for gpio driven led

config DRV_LED_PWM
	prompt "Enable pwm led driver"
	bool
	default n
	help
		This option enables support for pwm driven led

config DRV_LED_LSTRIP
	prompt "Enable lstrip led driver"
	bool
	default n
	help
		This option enables support for lstrip led

endmenu
```

## xstar/driver/ledtrigger/Kconfig
```kconfig
menu "LED Trigger Support"

config DRV_LEDTRIGGER_HEARTBEAT
	prompt "Enable heartbeat LED trigger"
	bool
	default n

config DRV_LEDTRIGGER_BREATHING
	prompt "Enable breathing LED trigger"
	bool
	default n

config DRV_LEDTRIGGER_GENERAL
	prompt "Enable general LED trigger"
	bool
	default n

endmenu
```

## xstar/driver/limiter/Kconfig
```kconfig
menu "Limiter Support"

config DRV_LIMITER_GPIO_POLLED
	prompt "Enable GPIO polled limiter driver"
	bool
	default n

endmenu
```

## xstar/driver/motor/Kconfig
```kconfig
menu "Motor Support"

config DRV_MOTOR_GPIO
	prompt "Enable GPIO motor driver"
	bool
	default n

endmenu
```

## xstar/driver/nvmem/Kconfig
```kconfig
menu "NVMEM Support"

config DRV_NVMEM_AT24C02
	prompt "Enable AT24C02 eeprom nvmem driver"
	bool
	default n

config DRV_NVMEM_OTP
	prompt "Enable OTP nvmem driver"
	bool
	default n

endmenu
```

## xstar/driver/pressure/Kconfig
```kconfig
menu "Pressure Support"

config DRV_PRESSURE_BMP280
	prompt "Enable BMP280 pressure driver"
	bool
	default n

endmenu
```

## xstar/driver/printer/Kconfig
```kconfig
menu "Printer Support"

config DRV_PRINTER_THERMAL
	prompt "Enable thermal printer driver"
	bool
	default n

endmenu
```

## xstar/driver/proximity/Kconfig
```kconfig
menu "Proximity Support"

config DRV_PROXIMITY_GPIO
	prompt "Enable GPIO proximity sensor driver"
	bool
	default n

endmenu
```

## xstar/driver/pwm/Kconfig
```kconfig
menu "PWM Support"

config DRV_PWM_GPIO
	prompt "Enable GPIO PWM driver"
	bool
	default n

config DRV_PWM_PCA9685
	prompt "Enable PCA9685 PWM driver"
	bool
	default n

endmenu
```

## xstar/driver/regulator/Kconfig
```kconfig
menu "Regulator Support"

config DRV_REGULATOR_GPIO
	prompt "Enable GPIO regulator driver"
	bool
	default n

endmenu
```

## xstar/driver/sd/Kconfig
```kconfig
menu "SD Support"

config DRV_SD_SDHCI_SPI
	prompt "Enable SDHCI SPI driver"
	bool
	default y

endmenu
```

## xstar/driver/servo/Kconfig
```kconfig
menu "Servo Support"

config DRV_SERVO_PWM
	prompt "Enable PWM servo driver"
	bool
	default n

endmenu
```

## xstar/driver/spi/Kconfig
```kconfig
menu "SPI Support"

config DRV_SPI_GPIO
	prompt "Enable GPIO SPI driver"
	bool
	default n

endmenu
```
