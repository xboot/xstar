## xstar/driver/Kconfig
```kconfig
menu "Device Drivers"

source "xstar/driver/adc/Kconfig"
source "xstar/driver/atnet/Kconfig"
source "xstar/driver/atomic/Kconfig"
source "xstar/driver/audio/Kconfig"
source "xstar/driver/battery/Kconfig"
source "xstar/driver/block/Kconfig"
source "xstar/driver/buzzer/Kconfig"
source "xstar/driver/camera/Kconfig"
source "xstar/driver/clk/Kconfig"
source "xstar/driver/clockevent/Kconfig"
source "xstar/driver/clocksource/Kconfig"
source "xstar/driver/compass/Kconfig"
source "xstar/driver/console/Kconfig"
source "xstar/driver/dac/Kconfig"
source "xstar/driver/dma/Kconfig"
source "xstar/driver/framebuffer/Kconfig"
source "xstar/driver/g2d/Kconfig"
source "xstar/driver/gmeter/Kconfig"
source "xstar/driver/gnss/Kconfig"
source "xstar/driver/gpio/Kconfig"
source "xstar/driver/gyroscope/Kconfig"
source "xstar/driver/hygrometer/Kconfig"
source "xstar/driver/i2c/Kconfig"
source "xstar/driver/input/Kconfig"
source "xstar/driver/interrupt/Kconfig"
source "xstar/driver/led/Kconfig"
source "xstar/driver/ledstrip/Kconfig"
source "xstar/driver/ledtrigger/Kconfig"
source "xstar/driver/light/Kconfig"
source "xstar/driver/limiter/Kconfig"
source "xstar/driver/motor/Kconfig"
source "xstar/driver/net/Kconfig"
source "xstar/driver/nvmem/Kconfig"
source "xstar/driver/oximeter/Kconfig"
source "xstar/driver/pressure/Kconfig"
source "xstar/driver/printer/Kconfig"
source "xstar/driver/proximity/Kconfig"
source "xstar/driver/pwm/Kconfig"
source "xstar/driver/regulator/Kconfig"
source "xstar/driver/reset/Kconfig"
source "xstar/driver/rng/Kconfig"
source "xstar/driver/rtc/Kconfig"
source "xstar/driver/sd/Kconfig"
source "xstar/driver/servo/Kconfig"
source "xstar/driver/spi/Kconfig"
source "xstar/driver/spinlock/Kconfig"
source "xstar/driver/stepper/Kconfig"
source "xstar/driver/thermometer/Kconfig"
source "xstar/driver/uart/Kconfig"
source "xstar/driver/vibrator/Kconfig"
source "xstar/driver/watchdog/Kconfig"

endmenu
```

## xstar/driver/adc/Kconfig
```kconfig
menu "ADC Support"

config DRV_ADC_ADS1015
	prompt "Enable ADS1015 ADC driver"
	bool
	default n

endmenu
```

## xstar/driver/atnet/Kconfig
```kconfig
menu "ATNET Support"

config DRV_ATNET_ML307
	prompt "Enable ML307 ATNET driver"
	bool
	default n

endmenu
```

## xstar/driver/audio/Kconfig
```kconfig
menu "Audio Support"

config DRV_AUDIO_PLAYBACK_PWM
	prompt "Enable PWM audio playback driver"
	bool
	default n

endmenu
```

## xstar/driver/battery/Kconfig
```kconfig
menu "Battery Support"

config DRV_BATTERY_ADC
	prompt "Enable ADC battery driver"
	bool
	default n

config DRV_BATTERY_SBS
	prompt "Enable SBS battery driver"
	bool
	default n

endmenu
```

## xstar/driver/block/Kconfig
```kconfig
menu "Block Device Support"

config DRV_BLOCK_RAMDISK
	prompt "Enable RAM disk driver"
	bool
	default n

config DRV_BLOCK_ROMDISK
	prompt "Enable ROM disk driver"
	bool
	default n

config DRV_BLOCK_SPINAND
	prompt "Enable SPI NAND driver"
	bool
	default n

config DRV_BLOCK_SPINOR
	prompt "Enable SPI NOR driver"
	bool
	default n

endmenu
```

## xstar/driver/buzzer/Kconfig
```kconfig
menu "Buzzer Support"

config DRV_BUZZER_GPIO
	prompt "Enable GPIO buzzer driver"
	bool
	default n

config DRV_BUZZER_PWM
	prompt "Enable PWM buzzer driver"
	bool
	default n

endmenu
```

## xstar/driver/clk/Kconfig
```kconfig
menu "Clock Support"

config DRV_CLK_COMP
	prompt "Enable clock composite driver"
	bool
	default n

config DRV_CLK_DIVIDER
	prompt "Enable clock divider driver"
	bool
	default n

config DRV_CLK_FIXED_FACTOR
	prompt "Enable clock fixed factor driver"
	bool
	default n

config DRV_CLK_FIXED
	prompt "Enable clock fixed driver"
	bool
	default n

config DRV_CLK_GATE
	prompt "Enable clock gate driver"
	bool
	default n

config DRV_CLK_LINK
	prompt "Enable clock link driver"
	bool
	default n

config DRV_CLK_MUX
	prompt "Enable clock mux driver"
	bool
	default n

config DRV_CLK_RATIO
	prompt "Enable clock ratio driver"
	bool
	default n

endmenu
```

## xstar/driver/compass/Kconfig
```kconfig
menu "Compass Support"

config DRV_COMPASS_HMC5883L
	prompt "Enable HMC5883L compass driver"
	bool
	default n

endmenu
```

## xstar/driver/console/Kconfig
```kconfig
menu "Console Support"

config DRV_CONSOLE_UART
	prompt "Enable UART console driver"
	bool
	default n

endmenu
```

## xstar/driver/framebuffer/Kconfig
```kconfig
menu "Framebuffer Support"

config DRV_FRAMEBUFFER_GC9107
	prompt "Enable GC9107 framebuffer driver"
	bool
	default n

config DRV_FRAMEBUFFER_GC9B72
	prompt "Enable GC9B72 framebuffer driver"
	bool
	default n

config DRV_FRAMEBUFFER_GC9D01
	prompt "Enable GC9D01 framebuffer driver"
	bool
	default n

config DRV_FRAMEBUFFER_NV3031B
	prompt "Enable NV3031B framebuffer driver"
	bool
	default n

config DRV_FRAMEBUFFER_NV3041A
	prompt "Enable NV3041A framebuffer driver"
	bool
	default n

config DRV_FRAMEBUFFER_SSD1308
	prompt "Enable SSD1308 framebuffer driver"
	bool
	default n

config DRV_FRAMEBUFFER_ST7735P3
	prompt "Enable ST7735P3 framebuffer driver"
	bool
	default n

config DRV_FRAMEBUFFER_ST7789P3
	prompt "Enable ST7789P3 framebuffer driver"
	bool
	default n

config DRV_FRAMEBUFFER_ST77912
	prompt "Enable ST77912 framebuffer driver"
	bool
	default n

endmenu
```

## xstar/driver/gmeter/Kconfig
```kconfig
menu "Gravity Meter Support"

config DRV_GMETER_AXDL345
	prompt "Enable AXDL345 gravity meter driver"
	bool
	default n

endmenu
```

## xstar/driver/gnss/Kconfig
```kconfig
menu "GNSS Support"

config DRV_GNSS_UART
	prompt "Enable UART GNSS driver"
	bool
	default n

endmenu
```

## xstar/driver/gpio/Kconfig
```kconfig
menu "GPIO Support"

config DRV_GPIO_MCP23017
	prompt "Enable MCP23017 GPIO expander driver"
	bool
	default n

config DRV_GPIO_PCF8574
	prompt "Enable PCF8574 GPIO expander driver"
	bool
	default n

endmenu
```

## xstar/driver/hygrometer/Kconfig
```kconfig
menu "Hygrometer Support"

config DRV_HYGROMETER_AHT20
	prompt "Enable AHT20 hygrometer driver"
	bool
	default n

endmenu
```

## xstar/driver/i2c/Kconfig
```kconfig
menu "I2C Support"

config DRV_I2C_GPIO
	prompt "Enable GPIO I2C driver"
	bool
	default n

endmenu
```

## xstar/driver/input/Kconfig
```kconfig
menu "Input Support"

source "xstar/driver/input/key/Kconfig"
source "xstar/driver/input/rc/Kconfig"
source "xstar/driver/input/rotary/Kconfig"
source "xstar/driver/input/touchscreen/Kconfig"

endmenu
```
